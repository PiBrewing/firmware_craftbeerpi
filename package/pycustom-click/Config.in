## package/pycustom-click/Config.in
```kconfig
config BR2_PACKAGE_PYCUSTOM_CLICK
	bool "pycustom-click"
	select BR2_PACKAGE_PYTHON_COLORAMA # runtime
	select BR2_PACKAGE_PYTHON_IMPORTLIB_METADATA # runtime

	depends on !BR2_PACKAGE_PYTHON_CLICK
	help
	  Composable command line interface toolkit.

	  https://palletsprojects.com/p/click/
```

## package/pycustom-cryptography/Config.in
```kconfig
config BR2_PACKAGE_PYCUSTOM_CRYPTOGRAPHY
	bool "pycustom-cryptography"
	select BR2_PACKAGE_PYTHON_SETUPTOOLS_RUST

	depends on !BR2_PACKAGE_PYTHON_CRYPTOGRAPHY
	help
	  cryptography is a package which provides cryptographic
	  recipes and primitives to Python developers.

	  https://github.com/pyca/cryptography
```

## package/pycustom-gpiozero/Config.in
```kconfig
config BR2_PACKAGE_PYCUSTOM_GPIOZERO
	bool "python-gpiozero"
	depends on BR2_arm || BR2_aarch64
	select BR2_PACKAGE_PYTHON_COLORZERO # runtime
	select BR2_PACKAGE_PYTHON_RPI_GPIO # runtime
	select BR2_PACKAGE_PYTHON_SETUPTOOLS # runtime
	help
	  A simple interface to GPIO devices with Raspberry Pi.

	  https://github.com/gpiozero/gpiozero
```

## package/pycustom-numpy/Config.in
```kconfig
config BR2_PACKAGE_PYCUSTOM_NUMPY
	bool "pycustom-numpy"

	depends on !BR2_PACKAGE_PYTHON_NUMPY
	help
	  NumPy is the fundamental package for array computing with
	  Python.

	  https://www.numpy.org
```

## package/pycustom-prompt-toolkit/Config.in
```kconfig
config BR2_PACKAGE_PYCUSTOM_PROMPT_TOOLKIT
	bool "pycustom-prompt-toolkit"
	select BR2_PACKAGE_PYTHON_SIX # runtime
	select BR2_PACKAGE_PYCUSTOM_WCWIDTH # runtime

	depends on !BR2_PACKAGE_PYTHON_PROMPT_TOOLKIT
	help
	  Library for building powerful interactive command lines in
	  Python.

	  https://github.com/jonathanslenders/python-prompt-toolkit
```

## package/pycustom-psutil/Config.in
```kconfig
config BR2_PACKAGE_PYCUSTOM_PSUTIL
	bool "pycustom-psutil"

	depends on !BR2_PACKAGE_PYTHON_PSUTIL
	help
	  Cross-platform lib for process and system monitoring in
	  Python.

	  https://github.com/giampaolo/psutil
```

## package/pycustom-requests/Config.in
```kconfig
config BR2_PACKAGE_PYCUSTOM_REQUESTS
	bool "pycustom-requests"
	select BR2_PACKAGE_PYTHON_CERTIFI # runtime
	select BR2_PACKAGE_PYTHON_CHARDET # runtime
	select BR2_PACKAGE_PYTHON_CHARSET_NORMALIZER # runtime
	select BR2_PACKAGE_PYTHON_IDNA # runtime
	select BR2_PACKAGE_PYTHON_IDNA # runtime
	select BR2_PACKAGE_PYTHON_URLLIB3 # runtime

	depends on !BR2_PACKAGE_PYTHON_REQUESTS
	help
	  Python HTTP for Humans.

	  https://requests.readthedocs.io
```

## package/pycustom-tabulate/Config.in
```kconfig
config BR2_PACKAGE_PYCUSTOM_TABULATE
	bool "pycustom-tabulate"
	help
	  Pretty-print tabular data.

	  https://github.com/astanin/python-tabulate
```

## package/pycustom-typing-extensions/Config.in
```kconfig
config BR2_PACKAGE_PYCUSTOM_TYPING_EXTENSIONS

	depends on !BR2_PACKAGE_PYTHON_TYPING_EXTENSIONS
	bool "pycustom-typing-extensions"
	help
```

## package/pycustom-wcwidth/Config.in
```kconfig
config BR2_PACKAGE_PYCUSTOM_WCWIDTH
	bool "pycustom-wcwidth"
	
	depends on !BR2_PACKAGE_PYTHON_WCWIDTH
	help
	  Measures the displayed width of unicode strings in a
	  terminal.

	  https://github.com/jquast/wcwidth
```

## package/python-aiohttp-auth/Config.in
```kconfig
config BR2_PACKAGE_PYTHON_AIOHTTP_AUTH
	bool "python-aiohttp-auth"
	select BR2_PACKAGE_PYCUSTOM_AIOHTTP # runtime
	select BR2_PACKAGE_PYTHON_TICKET_AUTH # runtime
	help
	  Authorization and authentication middleware plugin for
	  aiohttp.

	  https://github.com/gnarlychicken/aiohttp_auth
```

## package/python-aiohttp-route-decorator/Config.in
```kconfig
config BR2_PACKAGE_PYTHON_AIOHTTP_ROUTE_DECORATOR
	bool "python-aiohttp-route-decorator"
	select BR2_PACKAGE_PYTHON_AIOHTTP # runtime
	help
	  aiohttp @route decorator that doesn't need the app
	  singleton.

	  https://github.com/IlyaSemenov/aiohttp_route_decorator
```

## package/python-aiohttp-session/Config.in
```kconfig
config BR2_PACKAGE_PYTHON_AIOHTTP_SESSION
	bool "python-aiohttp-session"
	select BR2_PACKAGE_PYTHON_AIOHTTP # runtime
	select BR2_PACKAGE_PYTHON_TYPING_EXTENSIONS # runtime
	help
	  sessions for aiohttp.web.

	  https://github.com/aio-libs/aiohttp_session/
```

## package/python-asyncio-mqtt/Config.in
```kconfig
config BR2_PACKAGE_PYTHON_ASYNCIO_MQTT
	bool "python-asyncio-mqtt"
	select BR2_PACKAGE_PYTHON_ASYNC_GENERATOR # runtime
	select BR2_PACKAGE_PYTHON_PAHO_MQTT # runtime
	select BR2_PACKAGE_PYTHON_TYPING_EXTENSIONS # runtime
	help
	  Idomatic asyncio wrapper around paho-mqtt.

	  https://github.com/sbtinstruments/asyncio-mqtt
```

## package/python-importlib-metadata/Config.in
```kconfig
config BR2_PACKAGE_PYTHON_IMPORTLIB_METADATA
	bool "python-importlib-metadata"
	help
	  Read metadata from Python packages.

	  https://github.com/python/importlib_metadata
```

## package/python-paho-mqtt-custom/Config.in
```kconfig
config BR2_PACKAGE_PYTHON_PAHO_MQTT_CUSTOM
	bool "python-paho-mqtt-custom"
	help
	  MQTT version 5.0/3.1.1 client class.

	  http://eclipse.org/paho
```

## package/python-pandas/Config.in
```kconfig
config BR2_PACKAGE_PYTHON_PANDAS
	bool "python-pandas"
	select BR2_PACKAGE_PYTHON_CYTHON
	select BR2_PACKAGE_PYTHON_NUMPY
	help
	  Powerful data structures for data analysis, time series, and statistics

	 https://pandas.pydata.org/
```

## package/python-prompt-toolkit-custom/Config.in
```kconfig
config BR2_PACKAGE_PYTHON_PROMPT_TOOLKIT_CUSTOM
	bool "python-prompt-toolkit-custom"
	select BR2_PACKAGE_PYTHON_SIX # runtime
	select BR2_PACKAGE_PYTHON_WCWIDTH # runtime
	select BR2_PACKAGE_PYTHON3_PYEXPAT # runtime
	help
	  Library for building powerful interactive command lines in
	  Python.

	  https://github.com/prompt-toolkit/python-prompt-toolkit
```

## package/python-pyfiglet/Config.in
```kconfig
config BR2_PACKAGE_PYTHON_PYFIGLET
	bool "python-pyfiglet"
	help
	  Pure-python FIGlet implementation.

	  https://github.com/pwaller/pyfiglet
```

## package/python-pyinquirer/Config.in
```kconfig
config BR2_PACKAGE_PYTHON_PYINQUIRER
	bool "python-pyinquirer"
	select BR2_PACKAGE_PYTHON_PROMPT_TOOLKIT # runtime
	select BR2_PACKAGE_PYTHON_PYGMENTS # runtime
	select BR2_PACKAGE_PYTHON_REGEX # runtime
	help
	  A Python module for collection of common interactive
	  command line user interfaces, based on Inquirer.js.

	  https://github.com/CITGuru/PyInquirer/
```

## package/python-pytest-aiohttp/Config.in
```kconfig
config BR2_PACKAGE_PYTHON_PYTEST_AIOHTTP
	bool "python-pytest-aiohttp"
	help
	  Pytest plugin for aiohttp support

	  https://github.com/aio-libs/pytest-aiohttp
```

## package/python-shortuuid/Config.in
```kconfig
config BR2_PACKAGE_PYTHON_SHORTUUID
	bool "python-shortuuid"
	help
	  A generator library for concise, unambiguous and URL-safe
	  UUIDs.

	  https://github.com/skorokithakis/shortuuid/
```

## package/python-tabulate/Config.in
```kconfig
config BR2_PACKAGE_PYTHON_TABULATE
	bool "python-tabulate"
	help
	  Pretty-print tabular data.

	  https://github.com/astanin/python-tabulate
```

## package/python-ticket-auth/Config.in
```kconfig
config BR2_PACKAGE_PYTHON_TICKET_AUTH
	bool "python-ticket-auth"
	help
	  Ticket authentication system similar to mod_auth_tkt used
	  by Apache.

	  https://github.com/gnarlychicken/ticket_auth
```

## package/python-voluptuous/Config.in
```kconfig
config BR2_PACKAGE_PYTHON_VOLUPTUOUS
	bool "python-voluptuous"
	help

	  https://github.com/alecthomas/voluptuous
```
