## package/craftbeerpi-ispindle/Config.in
```kconfig
config BR2_PACKAGE_CRAFTBEERPI_ISPINDLE
    bool "craftbeerpi_ispindle"
    depends on BR2_PACKAGE_CRAFTBEERPI
    help
    CraftBeerPi Plugin: Sensor that collects data from the iSpindle
```

## package/craftbeerpi-kettle_sensor/Config.in
```kconfig
config BR2_PACKAGE_CRAFTBEERPI_KETTLE_SENSOR
    bool "craftbeerpi_kettle_sensor"
    depends on BR2_PACKAGE_CRAFTBEERPI
    help
    CraftBeerPi Plugin: Collects targettemp and power/status for kettle / fermenter
```

## package/craftbeerpi-lcdisplay/Config.in
```kconfig
config BR2_PACKAGE_CRAFTBEERPI_LCDISPLAY
    bool "craftbeerpi_lcdisplay"
    depends on BR2_PACKAGE_CRAFTBEERPI
    help
    CraftBeerPi Plugin: Allows usage of LCD Display (I2C)
```

## package/craftbeerpi-lcdisplay2/Config.in
```kconfig
config BR2_PACKAGE_CRAFTBEERPI_LCDISPLAY2
    bool "craftbeerpi_lcdisplay2"
    depends on BR2_PACKAGE_CRAFTBEERPI
    help
    CraftBeerPi Plugin: Modded Fork that allows also Display of Fermentation with Fermenter Hysteresis Plugin
```

## package/craftbeerpi-nextion_display/Config.in
```kconfig
config BR2_PACKAGE_CRAFTBEERPI_NEXTION_DISPLAY
    bool "craftbeerpi_nextion_display"
    depends on BR2_PACKAGE_CRAFTBEERPI
    help
    CraftBeerPi Plugin: Use Nextion Display on CraftbeerPi4
```

## package/craftbeerpi-pca9685/Config.in
```kconfig
config BR2_PACKAGE_CRAFTBEERPI_PCA9685
    bool "craftbeerpi_pca9685"
    depends on BR2_PACKAGE_CRAFTBEERPI
    help
    CraftBeerPi Plugin: PCA9685 I2C PWM Actor Plugin for CraftBeerPi4
```

## package/craftbeerpi-pcf8574_gpio/Config.in
```kconfig
config BR2_PACKAGE_CRAFTBEERPI_PCF8574_GPIO
    bool "craftbeerpi_pcf8574_gpio"
    depends on BR2_PACKAGE_CRAFTBEERPI
    help
    CraftBeerPi Plugin: Extend PI's GPIO Actors by 8 via I2C device
```

## package/craftbeerpi-pid_autotune/Config.in
```kconfig
config BR2_PACKAGE_CRAFTBEERPI_PID_AUTOTUNE
    bool "craftbeerpi_pid_autotune"
    depends on BR2_PACKAGE_CRAFTBEERPI
    help
    CraftBeerPi Plugin: Kettle controller that can be used to determine the PID parameters for the PID based Kettle controllers
```

## package/craftbeerpi-pid_boil/Config.in
```kconfig
config BR2_PACKAGE_CRAFTBEERPI_PID_BOIL
    bool "craftbeerpi_pid_boil"
    depends on BR2_PACKAGE_CRAFTBEERPI
    help
    CraftBeerPi Plugin: Kettle controller with PID logic and Boil power parameter
```

## package/craftbeerpi-pid_herms/Config.in
```kconfig
config BR2_PACKAGE_CRAFTBEERPI_PID_HERMS
    bool "craftbeerpi_pid_herms"
    depends on BR2_PACKAGE_CRAFTBEERPI
    help
    CraftBeerPi Plugin: Kettle controller with PID logic, Boil power parameter and HLT temp sensor condition
```

## package/craftbeerpi-pt100x/Config.in
```kconfig
config BR2_PACKAGE_CRAFTBEERPI_PT100X
	bool "craftbeerpi_pt100x"
	depends on BR2_PACKAGE_CRAFTBEERPI
	help
	  CraftBeerPi Plugin: PT100/PT1000 Temp Sensor
```

## package/craftbeerpi-push_over/Config.in
```kconfig
config BR2_PACKAGE_CRAFTBEERPI_PUSH_OVER
    bool "craftbeerpi_push_over"
    depends on BR2_PACKAGE_CRAFTBEERPI
    help
    CraftBeerPi Plugin: Forwards cbpi4 messages to Pushover push message service
```

## package/craftbeerpi-recipe_import/Config.in
```kconfig
config BR2_PACKAGE_CRAFTBEERPI_RECIPE_IMPORT
    bool "craftbeerpi_recipe_import"
    depends on BR2_PACKAGE_CRAFTBEERPI
    help
    CraftBeerPi Plugin: Example Plugin to customize automated recipe creation
```

## package/craftbeerpi-scd30_co2_sensor/Config.in
```kconfig
config BR2_PACKAGE_CRAFTBEERPI_SCD30_CO2_SENSOR
    bool "craftbeerpi_scd30_co2_sensor"
    depends on BR2_PACKAGE_CRAFTBEERPI
    help
    CraftBeerPi Plugin: Temp, Rel. Humidity and CO2 sensor (I2C based)
```

## package/craftbeerpi-system/Config.in
```kconfig
config BR2_PACKAGE_CRAFTBEERPI_SYSTEM
    bool "craftbeerpi_system"
    depends on BR2_PACKAGE_CRAFTBEERPI
    help
    CraftBeerPi Plugin: System Sensors: Temp, CPU load, Memory
```

## package/craftbeerpi-telegram/Config.in
```kconfig
config BR2_PACKAGE_CRAFTBEERPI_TELEGRAM
    bool "craftbeerpi_telegram"
    depends on BR2_PACKAGE_CRAFTBEERPI
    help
    CraftBeerPi Plugin: Telegram Push Notifications for Craftbeerpi 4
```

## package/craftbeerpi-triac_hat_actor/Config.in
```kconfig
config BR2_PACKAGE_CRAFTBEERPI_TRIAC_HAT_ACTOR
    bool "craftbeerpi_triac_hat_actor"
    depends on BR2_PACKAGE_CRAFTBEERPI
    help
    CraftBeerPi Plugin: Plugin for using Waveshare's 2CH Triac Hat for controlling actors in CraftBeerPi
```

## package/craftbeerpi-ui/Config.in
```kconfig
config BR2_PACKAGE_CRAFTBEERPI_UI
    bool "craftbeerpi_ui"
    depends on BR2_PACKAGE_CRAFTBEERPI
    help
    CraftBeerPi Plugin: Web UI
```

## package/craftbeerpi/Config.in
```kconfig
config BR2_PACKAGE_CRAFTBEERPI
	bool "craftbeerpi"
	select BR2_PACKAGE_PYTHON3
	select BR2_PACKAGE_PYTHON_REQUESTS
	select BR2_PACKAGE_PYTHON_AIOHTTP
	select BR2_PACKAGE_PYTHON_AIOHTTP_AUTH
	select BR2_PACKAGE_PYTHON_AIOHTTP_ROUTE_DECORATOR
	select BR2_PACKAGE_PYTHON_AIOHTTP_SECURITY
	select BR2_PACKAGE_PYTHON_AIOHTTP_SESSION
	select BR2_PACKAGE_PYTHON_AIOHTTP_SWAGGER
	select BR2_PACKAGE_PYTHON_AIOJOBS
	select BR2_PACKAGE_PYTHON_AIOSQLITE
	select BR2_PACKAGE_PYTHON_CRYPTOGRAPHY
	select BR2_PACKAGE_PYTHON_VOLUPTUOUS
	select BR2_PACKAGE_PYTHON_PYFIGLET
	select BR2_PACKAGE_PYTHON_PANDAS
	select BR2_PACKAGE_PYTHON_SHORTUUID
	select BR2_PACKAGE_PYTHON_TABULATE
	select BR2_PACKAGE_PYTHON_NUMPY
	select BR2_PACKAGE_PYTHON_CLICK
	select BR2_PACKAGE_PYTHON_IMPORTLIB_METADATA
	select BR2_PACKAGE_PYTHON_ASYNCIO_MQTT
	select BR2_PACKAGE_PYTHON_PSUTIL
	select BR2_PACKAGE_PYTHON_ZIPP
	select BR2_PACKAGE_PYTHON_PYINQUIRER
	select BR2_PACKAGE_PYTHON_COLORAMA
	select BR2_PACKAGE_PYTHON_PYTEST_AIOHTTP
	select BR2_PACKAGE_PYTHON_COVERAGE
	select BR2_PACKAGE_CRAFTBEERPI_UI
	select BR2_PACKAGE_PYTHON_DATEUTIL
	select BR2_PACKAGE_PYTHON_PYTZ
	help
	  An open source brewery automation system
```

## package/pycustom-aiohttp-security/Config.in
```kconfig
config BR2_PACKAGE_PYCUSTOM_AIOHTTP_SECURITY
	bool "pycustom-aiohttp-security"
	select BR2_PACKAGE_PYCUSTOM_AIOHTTP # runtime

	depends on !BR2_PACKAGE_PYTHON_AIOHTTP_SECURITY
	help
	  security for aiohttp.web.

	  https://github.com/aio-libs/aiohttp_security/
```

## package/pycustom-aiohttp-session/Config.in
```kconfig
config BR2_PACKAGE_PYCUSTOM_AIOHTTP_SESSION
	bool "pycustom-aiohttp-session"
	select BR2_PACKAGE_PYCUSTOM_AIOHTTP # runtime
	select BR2_PACKAGE_PYCUSTOM_TYPING_EXTENSIONS # runtime
	depends on !BR2_PACKAGE_PYTHON_AIOHTTP_SESSION
	help
	  sessions for aiohttp.web.

	  https://github.com/aio-libs/aiohttp_session/
```

## package/pycustom-aiohttp-swagger/Config.in
```kconfig
config BR2_PACKAGE_PYCUSTOM_AIOHTTP_SWAGGER
	bool "pycustom-aiohttp-swagger"
	select BR2_PACKAGE_PYCUSTOM_AIOHTTP # runtime
	select BR2_PACKAGE_PYTHON_JINJA2 # runtime
	select BR2_PACKAGE_PYTHON_PYYAML # runtime
	depends on !BR2_PACKAGE_PYTHON_AIOHTTP_SWAGGER
	help
	  Swagger API Documentation builder for aiohttp server.

	  https://github.com/cr0hn/aiohttp-swagger
```

## package/pycustom-aiohttp/Config.in
```kconfig
config BR2_PACKAGE_PYCUSTOM_AIOHTTP
	bool "pycustom-aiohttp"
	help
	  Async http client/server framework (asyncio).

	  https://github.com/aio-libs/aiohttp
```

## package/pycustom-aiojobs/Config.in
```kconfig
config BR2_PACKAGE_PYCUSTOM_AIOJOBS
	bool "pycustom-aiojobs"
	select BR2_PACKAGE_PYCUSTOM_ASYNC_TIMEOUT # runtime
	select BR2_PACKAGE_HOST_PYTHON_FLIT_CORE

	depends on !BR2_PACKAGE_PYTHON_AIOJOBS
	help
	  Jobs scheduler for managing background task (asyncio).

	  https://github.com/aio-libs/aiojobs
```

## package/pycustom-async-timeout/Config.in
```kconfig
config BR2_PACKAGE_PYCUSTOM_ASYNC_TIMEOUT
	bool "python-async-timeout"
	select BR2_PACKAGE_PYCUSTOM_TYPING_EXTENSIONS # runtime

	depends on !BR2_PACKAGE_PYTHON_ASYNC_TIMEOUT
	
	help
	  asyncio-compatible timeout context manager.

	  https://github.com/aio-libs/async-timeout
```
