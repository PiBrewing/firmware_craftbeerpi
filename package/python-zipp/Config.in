## package/python-zipp/Config.in
```kconfig
config BR2_PACKAGE_PYTHON_ZIPP
	bool "python-zipp"
	help
	  Backport of pathlib-compatible object wrapper for zip files

	  https://github.com/jaraco/zipp
```

## package/raucgithub/Config.in
```kconfig
config BR2_PACKAGE_RAUCGITHUB
	bool "raucgithub"
    select BR2_PACKAGE_HOST_GO_TARGET_ARCH_SUPPORTS
	help
	  Simple tool to check github for new firmware updates

	  https://github.com/dereulenspiegel/rauc-github
```
