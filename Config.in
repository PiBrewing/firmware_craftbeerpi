## package/cbpi4-buzzer/Config.in
```kconfig
config BR2_PACKAGE_CBPI4_BUZZER
	bool "cbpi4-buzzer"
	help
	  CraftBeerPi4 Buzzer Plugin.

	  https://github.com/avollkopf/cbpi4-buzzer
```

## package/cbpi4-flowmeter/Config.in
```kconfig
config BR2_PACKAGE_CBPI4_FLOWMETER
	bool "cbpi4-flowmeter"
	help
	  CraftBeerPi4 Flowsensor / Step Plugin.

	  https://github.com/avollkopf/cbpi4-Flowmeter
```

## package/cbpi4-groupedactor/Config.in
```kconfig
config BR2_PACKAGE_CBPI4_GROUPEDACTOR
	bool "cbpi4-groupedactor"
	help
	  CraftBeerPi Plugin.

	  https://github.com/avollkopf/cbpi4-GroupedActor
```

## package/cbpi4-groupedpoweractor/Config.in
```kconfig
config BR2_PACKAGE_CBPI4_GROUPEDPOWERACTOR
	bool "cbpi4-groupedpoweractor"
	help
	  CraftBeerPi4 Plugin to Group Actors.

	  https://github.com/avollkopf/cbpi4-GroupedPowerActor
```

## package/cbpi4-http-actor/Config.in
```kconfig
config BR2_PACKAGE_CBPI4_HTTP_ACTOR
	bool "cbpi4-http-actor"
	select BR2_PACKAGE_CRAFTBEERPI # runtime
	help
	  Generic CraftBeerPi HTTP Actor Plugin.

	  https://github.com/hurra/cbpi4-http-actor
```

## package/cbpi4-ispindle/Config.in
```kconfig
config BR2_PACKAGE_CBPI4_ISPINDLE
	bool "cbpi4-ispindle"
	help
	  CraftBeerPi4 iSpindle Sensor Plugin.

	  https://github.com/avollkopf/cbpi4-iSpindle
```

## package/cbpi4-kettlesensor/Config.in
```kconfig
config BR2_PACKAGE_CBPI4_KETTLESENSOR
	bool "cbpi4-kettlesensor"
	help
	  CraftBeerPi4 Plugin to add Sensor parameters for your
	  Kettle and Fermenter.

	  https://github.com/avollkopf/cbpi4-KettleSensor
```

## package/cbpi4-pidboil/Config.in
```kconfig
config BR2_PACKAGE_CBPI4_PIDBOIL
	bool "cbpi4-pidboil"
	help
	  CraftBeerPi4 PID Kettle Control Plugin.

	  https://github.com/avollkopf/cbpi4-PIDBoil
```

## package/cbpi4-pidherms/Config.in
```kconfig
config BR2_PACKAGE_CBPI4_PIDHERMS
	bool "cbpi4-pidherms"
	help
	  CraftBeerPi 4 Kettle Logic Plugin.

	  https://github.com/avollkopf/cbpi4-PIDHerms
```

## package/cbpi4-pt100x/Config.in
```kconfig
config BR2_PACKAGE_CBPI4_PT100X
	bool "cbpi4-pt100x"
	help
	  CraftBeerPi4 PT100/PT1000 Sensor Plugin.

	  https://github.com/avollkopf/cbpi4-pt100x
```

## package/cbpi4-system/Config.in
```kconfig
config BR2_PACKAGE_CBPI4_SYSTEM
	bool "cbpi4-system"
	select BR2_PACKAGE_PYCUSTOM_PSUTIL # runtime
	select BR2_PACKAGE_PYCUSTOM_GPIOZERO # runtime

	help
	  CraftBeerPi4 Plugin for system fucntions.

	  https://github.com/avollkopf/cbpi4-system
```

## package/craftbeerpi-bm_pid_smartboilwithPump/Config.in
```kconfig
config BR2_PACKAGE_CRAFTBEERPI_BM_PID_SMARTBOILWITHPUMP
    bool "craftbeerpi_bm_pid_smartboilwithPump"
    depends on BR2_PACKAGE_CRAFTBEERPI
    help
    CraftBeerPi Plugin: Kettle controller with PID logic, Boil power parameter and automated Pump control / protection (can be used for instance for Speidel Braumeister)
```

## package/craftbeerpi-bm_steps/Config.in
```kconfig
config BR2_PACKAGE_CRAFTBEERPI_BM_STEPS
    bool "craftbeerpi_bm_steps"
    depends on BR2_PACKAGE_CRAFTBEERPI
    help
    CraftBeerPi Plugin: Example Plugin for custom Mash steps
```

## package/craftbeerpi-buzzer/Config.in
```kconfig
config BR2_PACKAGE_CRAFTBEERPI_BUZZER
    bool "craftbeerpi_buzzer"
    depends on BR2_PACKAGE_CRAFTBEERPI
    help
    CraftBeerPi Plugin: Activates buzzer on cbpi4 messages
```

## package/craftbeerpi-dependent_actor/Config.in
```kconfig
config BR2_PACKAGE_CRAFTBEERPI_DEPENDENT_ACTOR
    bool "craftbeerpi_dependent_actor"
    depends on BR2_PACKAGE_CRAFTBEERPI
    help
    CraftBeerPi Plugin: Allows to switch actors dependent on the state of other actors
```

## package/craftbeerpi-dht22_temp_hum_sensor/Config.in
```kconfig
config BR2_PACKAGE_CRAFTBEERPI_DHT22_TEMP_HUM_SENSOR
    bool "craftbeerpi_dht22_temp_hum_sensor"
    depends on BR2_PACKAGE_CRAFTBEERPI
    help
    CraftBeerPi Plugin: Sensor for Reltive humidity and temperature
```

## package/craftbeerpi-fermenterstep/Config.in
```kconfig
config BR2_PACKAGE_CRAFTBEERPI_FERMENTERSTEP
    bool "craftbeerpi_fermenterstep"
    depends on BR2_PACKAGE_CRAFTBEERPI
    help
    CraftBeerPi Plugin: Plugin for Additional Fermentersteps
```

## package/craftbeerpi-flowmeter/Config.in
```kconfig
config BR2_PACKAGE_CRAFTBEERPI_FLOWMETER
    bool "craftbeerpi_flowmeter"
    depends on BR2_PACKAGE_CRAFTBEERPI
    help
    CraftBeerPi Plugin: Hall Sensor based Flowmeter Sensor
```

## package/craftbeerpi-gpio_dependent_actor/Config.in
```kconfig
config BR2_PACKAGE_CRAFTBEERPI_GPIO_DEPENDENT_ACTOR
    bool "craftbeerpi_gpio_dependent_actor"
    depends on BR2_PACKAGE_CRAFTBEERPI
    help
    CraftBeerPi Plugin: Allows to switch actors dependent on the state GPIO Inputs (alpha)
```

## package/craftbeerpi-grouped_actor/Config.in
```kconfig
config BR2_PACKAGE_CRAFTBEERPI_GROUPED_ACTOR
    bool "craftbeerpi_grouped_actor"
    depends on BR2_PACKAGE_CRAFTBEERPI
    help
    CraftBeerPi Plugin: Allows to group Actors
```

## package/craftbeerpi-grouped_powered_actor/Config.in
```kconfig
config BR2_PACKAGE_CRAFTBEERPI_GROUPED_POWERED_ACTOR
    bool "craftbeerpi_grouped_powered_actor"
    depends on BR2_PACKAGE_CRAFTBEERPI
    help
    CraftBeerPi Plugin: Allows to group Actors and ramp the power linear over the individual actors
```

## package/craftbeerpi-http_actor/Config.in
```kconfig
config BR2_PACKAGE_CRAFTBEERPI_HTTP_ACTOR
    bool "craftbeerpi_http_actor"
    depends on BR2_PACKAGE_CRAFTBEERPI
    help
    CraftBeerPi Plugin: Generic Craftbeerpi4 HTTP Actor Plugin
```

## package/craftbeerpi-hx711_loadcell/Config.in
```kconfig
config BR2_PACKAGE_CRAFTBEERPI_HX711_LOADCELL
    bool "craftbeerpi_hx711_loadcell"
    depends on BR2_PACKAGE_CRAFTBEERPI
    help
    CraftBeerPi Plugin: hx711 based Loadcell Sensor
```
