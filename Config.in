## Config.in
```kconfig
source "$BR2_EXTERNAL_CRAFTBEERPI_PATH/package/cbpi4-buzzer/Config.in"
source "$BR2_EXTERNAL_CRAFTBEERPI_PATH/package/cbpi4-flowmeter/Config.in"
source "$BR2_EXTERNAL_CRAFTBEERPI_PATH/package/cbpi4-groupedactor/Config.in"
source "$BR2_EXTERNAL_CRAFTBEERPI_PATH/package/cbpi4-groupedpoweractor/Config.in"
source "$BR2_EXTERNAL_CRAFTBEERPI_PATH/package/cbpi4-http-actor/Config.in"
source "$BR2_EXTERNAL_CRAFTBEERPI_PATH/package/cbpi4-ispindle/Config.in"
source "$BR2_EXTERNAL_CRAFTBEERPI_PATH/package/cbpi4-kettlesensor/Config.in"
source "$BR2_EXTERNAL_CRAFTBEERPI_PATH/package/cbpi4-pidboil/Config.in"
source "$BR2_EXTERNAL_CRAFTBEERPI_PATH/package/cbpi4-pidherms/Config.in"
source "$BR2_EXTERNAL_CRAFTBEERPI_PATH/package/cbpi4-pt100x/Config.in"
source "$BR2_EXTERNAL_CRAFTBEERPI_PATH/package/cbpi4-system/Config.in"
source "$BR2_EXTERNAL_CRAFTBEERPI_PATH/package/craftbeerpi/Config.in"
source "$BR2_EXTERNAL_CRAFTBEERPI_PATH/package/craftbeerpi-ui/Config.in"
source "$BR2_EXTERNAL_CRAFTBEERPI_PATH/package/pycustom-aiohttp/Config.in"
source "$BR2_EXTERNAL_CRAFTBEERPI_PATH/package/pycustom-aiohttp-security/Config.in"
source "$BR2_EXTERNAL_CRAFTBEERPI_PATH/package/pycustom-aiohttp-session/Config.in"
source "$BR2_EXTERNAL_CRAFTBEERPI_PATH/package/pycustom-aiohttp-swagger/Config.in"
source "$BR2_EXTERNAL_CRAFTBEERPI_PATH/package/pycustom-aiojobs/Config.in"
source "$BR2_EXTERNAL_CRAFTBEERPI_PATH/package/pycustom-async-timeout/Config.in"
source "$BR2_EXTERNAL_CRAFTBEERPI_PATH/package/pycustom-click/Config.in"
source "$BR2_EXTERNAL_CRAFTBEERPI_PATH/package/pycustom-cryptography/Config.in"
source "$BR2_EXTERNAL_CRAFTBEERPI_PATH/package/pycustom-gpiozero/Config.in"
source "$BR2_EXTERNAL_CRAFTBEERPI_PATH/package/pycustom-numpy/Config.in"
source "$BR2_EXTERNAL_CRAFTBEERPI_PATH/package/pycustom-prompt-toolkit/Config.in"
source "$BR2_EXTERNAL_CRAFTBEERPI_PATH/package/pycustom-psutil/Config.in"
source "$BR2_EXTERNAL_CRAFTBEERPI_PATH/package/pycustom-requests/Config.in"
source "$BR2_EXTERNAL_CRAFTBEERPI_PATH/package/pycustom-typing-extensions/Config.in"
source "$BR2_EXTERNAL_CRAFTBEERPI_PATH/package/pycustom-wcwidth/Config.in"
source "$BR2_EXTERNAL_CRAFTBEERPI_PATH/package/python-aiohttp-auth/Config.in"
source "$BR2_EXTERNAL_CRAFTBEERPI_PATH/package/python-aiohttp-route-decorator/Config.in"
source "$BR2_EXTERNAL_CRAFTBEERPI_PATH/package/python-aiosqlite/Config.in"
source "$BR2_EXTERNAL_CRAFTBEERPI_PATH/package/python-asyncio-mqtt/Config.in"
source "$BR2_EXTERNAL_CRAFTBEERPI_PATH/package/python-coverage/Config.in"
source "$BR2_EXTERNAL_CRAFTBEERPI_PATH/package/python-importlib-metadata/Config.in"
source "$BR2_EXTERNAL_CRAFTBEERPI_PATH/package/python-paho-mqtt-custom/Config.in"
source "$BR2_EXTERNAL_CRAFTBEERPI_PATH/package/python-pandas/Config.in"
source "$BR2_EXTERNAL_CRAFTBEERPI_PATH/package/python-pyfiglet/Config.in"
source "$BR2_EXTERNAL_CRAFTBEERPI_PATH/package/python-pyinquirer/Config.in"
source "$BR2_EXTERNAL_CRAFTBEERPI_PATH/package/python-pytest-aiohttp/Config.in"
source "$BR2_EXTERNAL_CRAFTBEERPI_PATH/package/python-shortuuid/Config.in"
source "$BR2_EXTERNAL_CRAFTBEERPI_PATH/package/python-tabulate/Config.in"
source "$BR2_EXTERNAL_CRAFTBEERPI_PATH/package/python-ticket-auth/Config.in"
source "$BR2_EXTERNAL_CRAFTBEERPI_PATH/package/python-voluptuous/Config.in"
source "$BR2_EXTERNAL_CRAFTBEERPI_PATH/package/python-zipp/Config.in"
source "$BR2_EXTERNAL_CRAFTBEERPI_PATH/package/raucgithub/Config.in"
```
